## src/modules/fw_gain_design/Kconfig
```kconfig
menuconfig MODULES_FW_GAIN_DESIGN
	bool "fw_gain_design"
	default n
	---help---
		Enable the fixed-wing aerodynamic gain-design advisory module.
```

## src/modules/fw_trim_estimator/Kconfig
```kconfig
menuconfig MODULES_FW_TRIM_ESTIMATOR
	bool "fw_trim_estimator"
	default n
	---help---
		Enable the fixed-wing in-flight roll and pitch trim estimator.
```
